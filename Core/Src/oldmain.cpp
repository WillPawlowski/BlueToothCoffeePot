/* USER CODE BEGIN Header */
/**
  ******************************************************************************
  * @file           : main.c
  * @brief          : Main program body
  ******************************************************************************
  * @attention
  *
  * Copyright (c) 2023 STMicroelectronics.
  * All rights reserved.
  *
  * This software is licensed under terms that can be found in the LICENSE file
  * in the root directory of this software component.
  * If no LICENSE file comes with this software, it is provided AS-IS.
  *
  ******************************************************************************
  */
/* USER CODE END Header */
/* Includes ------------------------------------------------------------------*/
#include "main.h"

/* Private includes ----------------------------------------------------------*/
/* USER CODE BEGIN Includes */
#include "retarget.h"
#include "lcd.h"
#include "JpgDecoder_STM.h"
#include <stdio.h>
#include <string.h>

const uint8_t jeanne[7320] = {
		0xff, 0xd8, 0xff, 0xe0, 0x0, 0x10, 0x4a, 0x46, 0x49, 0x46, 0x0, 0x1,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 0x34,
		0x34, 0x34, 0x34, 0x34, 0x34, 0x34, 0x34, 0x34, 0x34, 0x34, 0x34, 0x31,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 0x52,
		0x82, 0x92, 0xe1, 0xa2, 0xf1, 0x15, 0x33, 0x53, 0x63, 0xb2, 0xc2, 0x24,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 0x8,
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		0x8, 0x42, 0x10, 0x8, 0x42, 0x10, 0x8, 0x42, 0x10, 0x8, 0x42, 0x10, 0x8, 0x42, 0x10, 0x8, 0x42, 0x10, 0x8, 0x42, 0x10, 0x3f, 0xff, 0xd9
};

/* USER CODE END Includes */

/* Private variables ---------------------------------------------------------*/
SPI_HandleTypeDef hspi1;

UART_HandleTypeDef huart1;
UART_HandleTypeDef huart2;

/* Private function prototypes -----------------------------------------------*/
void SystemClock_Config(void);
static void MX_GPIO_Init(void);
static void MX_USART2_UART_Init(void);
static void MX_SPI1_Init(void);
static void MX_USART1_UART_Init(void);

/* Private user code ---------------------------------------------------------*/
/* USER CODE BEGIN 0 */

// we talk to the BT module using UART1;
# define BUFF_SIZE 512

uint8_t uartAReady = RESET;
uint8_t uartBReady = RESET;
char uartID = 'a';

int xPos = 0;
int yPos = 0;
uint16_t recievedData[15][8][8];

uint16_t convertToHex(uint16_t data)
{
	uint16_t response = 0;
	uint8_t byte1 = data >> 8;
	uint8_t byte2 = 0x00FF & data;
	response = byte1 < 0x61 ? (byte1 + 0xBC) << 8 : (byte1 + 0x99) << 8;
//	if(byte1 < 0x3A) //If byte is 0-9
//		response = (byte1 + 0xBC) << 8;
//	else	//Byte is a-f
//		response = (byte1 + 0x99) << 8;
	response += byte2 < 0x61 ? (byte2 + 0xBC): (byte2 + 0x99);
//	if(byte2 < 0x3A) //If byte is 0-9
//			response += (byte2 + 0xBC);
//		else	//Byte is a-f
//			response += (byte2 + 0x99);

	return response;
}


void displayMCU(int x, int y, uint16_t *colors)
{
	for(int i = 0; i<16; i++){
		for(int j = 0; j<16; j++){
			UG_DrawPixel(x+j , y+i, *(colors + i*16 + j));
			xPos = x;
			yPos = y;
		}
	}
}

uint8_t count = 0;
#define DECODE_BUFFER_LEN 3100
bool drawLCD(int16_t x, int16_t y, uint16_t w, uint16_t h, uint16_t* bitmap)
{
	printf("Count %d\r\n", count);
	count++;
	printf("x: %d\t y: %d\t w: %d\t h: %d\r\n", x, y, w, h);
	//displayMCU(x, y, bitmap);
	for(int i = 0; i<w; i++){
		for(int j = 0; j<h; j++){
			UG_DrawPixel(x+j , y+i, *(bitmap + i*16 + j));
			//displayMCU(x, y, bitmap);
			//printf("0x%x, ", *(bitmap+i*8+j));
		}
	}
  return 1; // 1 - to decode next block
}

/* USER CODE END 0 */

/**
  * @brief  The application entry point.
  * @retval int
  */
int main(void)
{
  /* MCU Configuration--------------------------------------------------------*/

  /* Reset of all peripherals, Initializes the Flash interface and the Systick. */
  HAL_Init();

  /* Configure the system clock */
  SystemClock_Config();

  /* Initialize all configured peripherals */
  MX_GPIO_Init();
  MX_USART2_UART_Init();
  MX_SPI1_Init();
  MX_USART1_UART_Init();
  /* USER CODE BEGIN 2 */
  RetargetInit(&huart2);
  LCD_init();
  UG_FillScreen(C_DEEP_PINK);
  /* USER CODE END 2 */

  /* Infinite loop */
  /* USER CODE BEGIN WHILE */
  uint8_t bytesA[BUFF_SIZE];
  uint8_t bytesB[BUFF_SIZE];
  /*TODO:
  	(maybe change first loop to while UART has no data)
  	(second loop to check if UART no longer has data?)
  	Find how to stop interrupt
  */
	uint16_t retVal, height, width;
	uint8_t decodeBuffer[DECODE_BUFFER_LEN]; //__attribute__((aligned(4)));
	JpgDecoder jpeg(drawLCD, decodeBuffer, DECODE_BUFFER_LEN);

	//retVal = jpeg.show(0, 0, jeanne, 7320);
	//printf("retVal: %d \r\n", retVal);

  //Get first set of data (maybe change to while UART has no data)
  printf("Entering Loop\r\n");
	HAL_UART_Receive_IT(&huart1, (uint8_t*) bytesA, BUFF_SIZE);
	while (1) {
		if (uartAReady == SET) {
			printf("received data\r\n");
			uartAReady = RESET;
			HAL_UART_Receive_IT(&huart1, (uint8_t*) bytesB, BUFF_SIZE);
			uartID = 'b';
			retVal = jpeg.show(0, 0, bytesA, BUFF_SIZE);
			printf("retVal: %d \r\n", retVal);
			retVal = jpeg.getDim(&width, &height, bytesA, BUFF_SIZE);
			printf("retVal: %d\t width: %d\t height: %d \r\n", retVal, width, height);
			break;
		}
	}

	//while(1);
	//Receive rest of data (check if UART no longer has data?)
  int busyCount = 0;
	while (1) {
		if (uartAReady == SET) {
			uartAReady = RESET;
			HAL_UART_Receive_IT(&huart1, (uint8_t*) bytesB, BUFF_SIZE);
			busyCount = 0;
			uartID = 'b';
			retVal = jpeg.show(xPos+16, yPos, bytesA, BUFF_SIZE);
			printf("retVal: %d \r\n", retVal);

		} else if (uartBReady == SET) {
			uartBReady = RESET;
			HAL_UART_Receive_IT(&huart1, (uint8_t*) bytesA, BUFF_SIZE);
			busyCount = 0;
			uartID = 'a';
			retVal = jpeg.show(xPos+16, yPos, bytesB, BUFF_SIZE);
			printf("retVal: %d \r\n", retVal);

		} else {
			if (huart1.RxState != HAL_UART_STATE_BUSY_RX) {
				busyCount++;
				if (busyCount > 1000000)
					break;
			}
		}

    /* USER CODE END WHILE */

    /* USER CODE BEGIN 3 */
  }
  //How to stop interrupt receive???
  printf("Broken\r\n");
  if(uartID == 'a'){
  	printf("BytesA End\r\n");
  } else {
  	printf("BytesB End\r\n");
  }

  /* USER CODE END 3 */
}

/**
  * @brief System Clock Configuration
  * @retval None
  */
void SystemClock_Config(void)
{
  RCC_OscInitTypeDef RCC_OscInitStruct = {0};
  RCC_ClkInitTypeDef RCC_ClkInitStruct = {0};
  RCC_PeriphCLKInitTypeDef PeriphClkInit = {0};

  /** Configure the main internal regulator output voltage
  */
  __HAL_PWR_VOLTAGESCALING_CONFIG(PWR_REGULATOR_VOLTAGE_SCALE1);

  /** Initializes the RCC Oscillators according to the specified parameters
  * in the RCC_OscInitTypeDef structure.
  */
  RCC_OscInitStruct.OscillatorType = RCC_OSCILLATORTYPE_HSI;
  RCC_OscInitStruct.HSIState = RCC_HSI_ON;
  RCC_OscInitStruct.HSICalibrationValue = RCC_HSICALIBRATION_DEFAULT;
  RCC_OscInitStruct.PLL.PLLState = RCC_PLL_NONE;
  if (HAL_RCC_OscConfig(&RCC_OscInitStruct) != HAL_OK)
  {
    Error_Handler();
  }

  /** Initializes the CPU, AHB and APB buses clocks
  */
  RCC_ClkInitStruct.ClockType = RCC_CLOCKTYPE_HCLK|RCC_CLOCKTYPE_SYSCLK
                              |RCC_CLOCKTYPE_PCLK1|RCC_CLOCKTYPE_PCLK2;
  RCC_ClkInitStruct.SYSCLKSource = RCC_SYSCLKSOURCE_HSI;
  RCC_ClkInitStruct.AHBCLKDivider = RCC_SYSCLK_DIV1;
  RCC_ClkInitStruct.APB1CLKDivider = RCC_HCLK_DIV1;
  RCC_ClkInitStruct.APB2CLKDivider = RCC_HCLK_DIV1;

  if (HAL_RCC_ClockConfig(&RCC_ClkInitStruct, FLASH_LATENCY_0) != HAL_OK)
  {
    Error_Handler();
  }
  PeriphClkInit.PeriphClockSelection = RCC_PERIPHCLK_USART1|RCC_PERIPHCLK_USART2;
  PeriphClkInit.Usart1ClockSelection = RCC_USART1CLKSOURCE_PCLK2;
  PeriphClkInit.Usart2ClockSelection = RCC_USART2CLKSOURCE_PCLK1;
  if (HAL_RCCEx_PeriphCLKConfig(&PeriphClkInit) != HAL_OK)
  {
    Error_Handler();
  }
}

/**
  * @brief SPI1 Initialization Function
  * @param None
  * @retval None
  */
static void MX_SPI1_Init(void)
{
  /* SPI1 parameter configuration*/
  hspi1.Instance = SPI1;
  hspi1.Init.Mode = SPI_MODE_MASTER;
  hspi1.Init.Direction = SPI_DIRECTION_2LINES;
  hspi1.Init.DataSize = SPI_DATASIZE_8BIT;
  hspi1.Init.CLKPolarity = SPI_POLARITY_LOW;
  hspi1.Init.CLKPhase = SPI_PHASE_1EDGE;
  hspi1.Init.NSS = SPI_NSS_SOFT;
  hspi1.Init.BaudRatePrescaler = SPI_BAUDRATEPRESCALER_2;
  hspi1.Init.FirstBit = SPI_FIRSTBIT_MSB;
  hspi1.Init.TIMode = SPI_TIMODE_DISABLE;
  hspi1.Init.CRCCalculation = SPI_CRCCALCULATION_DISABLE;
  hspi1.Init.CRCPolynomial = 7;
  if (HAL_SPI_Init(&hspi1) != HAL_OK)
  {
    Error_Handler();
  }
}

/**
  * @brief USART1 Initialization Function
  * @param None
  * @retval None
  */
static void MX_USART1_UART_Init(void)
{
  huart1.Instance = USART1;
  huart1.Init.BaudRate = 9600;
  huart1.Init.WordLength = UART_WORDLENGTH_8B;
  huart1.Init.StopBits = UART_STOPBITS_1;
  huart1.Init.Parity = UART_PARITY_NONE;
  huart1.Init.Mode = UART_MODE_TX_RX;
  huart1.Init.HwFlowCtl = UART_HWCONTROL_NONE;
  huart1.Init.OverSampling = UART_OVERSAMPLING_16;
  huart1.Init.OneBitSampling = UART_ONE_BIT_SAMPLE_DISABLE;
  huart1.AdvancedInit.AdvFeatureInit = UART_ADVFEATURE_NO_INIT;
  if (HAL_UART_Init(&huart1) != HAL_OK)
  {
    Error_Handler();
  }
  /* USER CODE BEGIN USART1_Init 2 */

  /* USER CODE END USART1_Init 2 */

}

/**
  * @brief USART2 Initialization Function
  * @param None
  * @retval None
  */
static void MX_USART2_UART_Init(void)
{
  huart2.Instance = USART2;
  huart2.Init.BaudRate = 115200;
  huart2.Init.WordLength = UART_WORDLENGTH_8B;
  huart2.Init.StopBits = UART_STOPBITS_1;
  huart2.Init.Parity = UART_PARITY_NONE;
  huart2.Init.Mode = UART_MODE_TX_RX;
  huart2.Init.HwFlowCtl = UART_HWCONTROL_NONE;
  huart2.Init.OverSampling = UART_OVERSAMPLING_16;
  huart2.Init.OneBitSampling = UART_ONE_BIT_SAMPLE_DISABLE;
  huart2.AdvancedInit.AdvFeatureInit = UART_ADVFEATURE_NO_INIT;
  if (HAL_UART_Init(&huart2) != HAL_OK)
  {
    Error_Handler();
  }
}

/**
  * @brief GPIO Initialization Function
  * @param None
  * @retval None
  */
static void MX_GPIO_Init(void)
{
  GPIO_InitTypeDef GPIO_InitStruct = {0};
/* USER CODE BEGIN MX_GPIO_Init_1 */
/* USER CODE END MX_GPIO_Init_1 */

  /* GPIO Ports Clock Enable */
  __HAL_RCC_GPIOC_CLK_ENABLE();
  __HAL_RCC_GPIOH_CLK_ENABLE();
  __HAL_RCC_GPIOA_CLK_ENABLE();
  __HAL_RCC_GPIOB_CLK_ENABLE();

  /*Configure GPIO pin Output Level */
  HAL_GPIO_WritePin(GPIOA, LD2_Pin|LCD_DC_Pin, GPIO_PIN_RESET);

  /*Configure GPIO pin Output Level */
  HAL_GPIO_WritePin(LCD_RST_GPIO_Port, LCD_RST_Pin, GPIO_PIN_RESET);

  /*Configure GPIO pin Output Level */
  HAL_GPIO_WritePin(LCD_CS_GPIO_Port, LCD_CS_Pin, GPIO_PIN_RESET);

  /*Configure GPIO pin : B1_Pin */
  GPIO_InitStruct.Pin = B1_Pin;
  GPIO_InitStruct.Mode = GPIO_MODE_IT_FALLING;
  GPIO_InitStruct.Pull = GPIO_NOPULL;
  HAL_GPIO_Init(B1_GPIO_Port, &GPIO_InitStruct);

  /*Configure GPIO pins : LD2_Pin LCD_DC_Pin */
  GPIO_InitStruct.Pin = LD2_Pin|LCD_DC_Pin;
  GPIO_InitStruct.Mode = GPIO_MODE_OUTPUT_PP;
  GPIO_InitStruct.Pull = GPIO_NOPULL;
  GPIO_InitStruct.Speed = GPIO_SPEED_FREQ_LOW;
  HAL_GPIO_Init(GPIOA, &GPIO_InitStruct);

  /*Configure GPIO pin : LCD_RST_Pin */
  GPIO_InitStruct.Pin = LCD_RST_Pin;
  GPIO_InitStruct.Mode = GPIO_MODE_OUTPUT_PP;
  GPIO_InitStruct.Pull = GPIO_NOPULL;
  GPIO_InitStruct.Speed = GPIO_SPEED_FREQ_LOW;
  HAL_GPIO_Init(LCD_RST_GPIO_Port, &GPIO_InitStruct);

  /*Configure GPIO pin : LCD_CS_Pin */
  GPIO_InitStruct.Pin = LCD_CS_Pin;
  GPIO_InitStruct.Mode = GPIO_MODE_OUTPUT_PP;
  GPIO_InitStruct.Pull = GPIO_NOPULL;
  GPIO_InitStruct.Speed = GPIO_SPEED_FREQ_LOW;
  HAL_GPIO_Init(LCD_CS_GPIO_Port, &GPIO_InitStruct);

/* USER CODE BEGIN MX_GPIO_Init_2 */
/* USER CODE END MX_GPIO_Init_2 */
}

/* USER CODE BEGIN 4 */

void USART2_IRQHandler()
{
	//General UART IRQ call
	HAL_UART_IRQHandler(&huart1);
}

void HAL_UART_RxCpltCallback(UART_HandleTypeDef *huart){
	//Let infinite loop know data has been received
	if(uartID == 'a')
		uartAReady = SET;
	else if(uartID == 'b')
		uartBReady = SET;
}


/* USER CODE END 4 */

/**
  * @brief  This function is executed in case of error occurrence.
  * @retval None
  */
void Error_Handler(void)
{
  /* USER CODE BEGIN Error_Handler_Debug */
  /* User can add his own implementation to report the HAL error return state */
  __disable_irq();
  while (1)
  {
  }
  /* USER CODE END Error_Handler_Debug */
}

#ifdef  USE_FULL_ASSERT
/**
  * @brief  Reports the name of the source file and the source line number
  *         where the assert_param error has occurred.
  * @param  file: pointer to the source file name
  * @param  line: assert_param error line source number
  * @retval None
  */
void assert_failed(uint8_t *file, uint32_t line)
{
  /* USER CODE BEGIN 6 */
  /* User can add his own implementation to report the file name and line number,
     ex: printf("Wrong parameters value: file %s on line %d\r\n", file, line) */
  /* USER CODE END 6 */
}
#endif /* USE_FULL_ASSERT */
